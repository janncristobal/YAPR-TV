## src/systemcmds/gimballed_rotors_test/Kconfig
```kconfig
menuconfig SYSTEMCMDS_GIMBALLED_ROTORS_TEST
	bool "gimballed_rotors_test"
	default n
	---help---
		Enable support for gimballed_rotors_test
```
